macro_shift_tap_dance: macro_shift_tap_dance{
compatible = "zmk,behavior-macro";
label = "macro_shift_tap_dance";
#binding-cells = <0>;
bindings = ;
};
macro_lock: macro_lock{
compatible = "zmk,behavior-macro";
label = "macro_lock";
#binding-cells = <0>;
bindings = <&kp LG(LC(Q))>;
};
macro_raycast: macro_raycast{
compatible = "zmk,behavior-macro";
label = "macro_raycast";
#binding-cells = <0>;
bindings = <&sk LGUI>, <&kp SPACE>;
};